## openwrt-25.12/package/network/services/hostapd/Config.in
```kconfig
# wpa_supplicant config
config WPA_RFKILL_SUPPORT
	bool "Add rfkill support"
	depends on PACKAGE_hostapd-common
	default n

config WPA_MSG_MIN_PRIORITY
	int "Minimum debug message priority"
	depends on PACKAGE_hostapd-common
	default 3
	help
	  Useful values are:
	    0 = all messages
		1 = raw message dumps
		2 = most debugging messages
		3 = info messages
		4 = warnings
		5 = errors

config WPA_WOLFSSL
	bool
	default PACKAGE_wpa-supplicant-wolfssl ||\
	        PACKAGE_wpad-wolfssl ||\
	        PACKAGE_wpad-basic-wolfssl || \
	        PACKAGE_wpad-mesh-wolfssl ||\
	        PACKAGE_eapol-test-wolfssl
	select WOLFSSL_HAS_AES_CCM
	select WOLFSSL_HAS_ARC4
	select WOLFSSL_HAS_DH
	select WOLFSSL_HAS_OCSP
	select WOLFSSL_HAS_SESSION_TICKET
	select WOLFSSL_HAS_WPAS

config DRIVER_11AC_SUPPORT
	bool
	default n

config DRIVER_11AX_SUPPORT
	bool
	default n
	select WPA_MBO_SUPPORT

config DRIVER_11BE_SUPPORT
	bool
	default n

config WPA_ENABLE_WEP
	bool "Enable support for unsecure and obsolete WEP"
	depends on PACKAGE_hostapd-common
	help
	  Wired equivalent privacy (WEP) is an obsolete cryptographic data
	  confidentiality algorithm that is not considered secure. It should not be used
	  for anything anymore. The functionality needed to use WEP is available in the
	  current hostapd release under this optional build parameter and completely
	  removed in a future release.

config WPA_MBO_SUPPORT
	bool "Multi Band Operation (Agile Multiband)"
	depends on PACKAGE_hostapd-common
	default y
	help
	  Multi Band Operation aka (Agile Multiband) enables features
	  that facilitate efficient use of multiple frequency bands.
	  Enabling MBO on an AP using RSN requires 802.11w to be enabled.
	  Hostapd will refuse to start if MBO and RSN are enabled without 11w.

config WPA_PQC_SUPPORT
	bool "Enable WPA-PQC (Post-Quantum Cryptography)"
	depends on PACKAGE_hostapd-pqc
	default y
	help
	  Enable Post-Quantum Cryptography support using liboqs library.
	  This enables support for quantum-resistant algorithms like Kyber768 (ML-KEM-768).
	  Requires liboqs library to be installed.
```
